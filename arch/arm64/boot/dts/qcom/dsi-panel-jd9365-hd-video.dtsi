/* Copyright (c) 2018, The Linux Foundation. All rights reserved.
 *
 * This program is free software; you can redistribute it and/or modify
 * it under the terms of the GNU General Public License version 2 and
 * only version 2 as published by the Free Software Foundation.
 *
 * This program is distributed in the hope that it will be useful,
 * but WITHOUT ANY WARRANTY; without even the implied warranty of
 * MERCHANTABILITY or FITNESS FOR A PARTICULAR PURPOSE.  See the
 * GNU General Public License for more details.
 */

&mdss_mdp {
    dsi_jd9365_hd_video: qcom,mdss_dsi_jd9365_hd_video{
		qcom,mdss-dsi-panel-controller = <&mdss_dsi0>;
		qcom,mdss-dsi-panel-name = "jd9365 hd video dsi panel";
		qcom,mdss-dsi-panel-type = "dsi_video_mode";
		qcom,mdss-dsi-panel-destination = "display_1";
		qcom,mdss-dsi-panel-framerate = <58>;
		qcom,mdss-dsi-virtual-channel-id = <0>;
		qcom,mdss-dsi-stream = <0>;
		qcom,mdss-dsi-panel-width = <720>;
		qcom,mdss-dsi-panel-height = <1520>;
		qcom,mdss-dsi-h-front-porch = <60>;
		qcom,mdss-dsi-h-back-porch = <60>;
		qcom,mdss-dsi-h-pulse-width = <20>;
		qcom,mdss-dsi-h-sync-skew = <0>;
		qcom,mdss-dsi-v-back-porch = <24>;
		qcom,mdss-dsi-v-front-porch = <12>;
		qcom,mdss-dsi-v-pulse-width = <4>;
		qcom,mdss-dsi-h-left-border = <0>;
		qcom,mdss-dsi-h-right-border = <0>;
		qcom,mdss-dsi-v-top-border = <0>;
		qcom,mdss-dsi-v-bottom-border = <0>;
		qcom,mdss-dsi-bpp = <24>;//24:rgb888,18:rgb666,16:rgb565
		qcom,mdss-dsi-color-order = "rgb_swap_rgb";
		qcom,mdss-dsi-underflow-color = <0xff>;
		qcom,mdss-dsi-border-color = <0>;
		qcom,mdss-dsi-off-command = [05 01 00 00 32 00 02 28 00
			05 01 00 00 78 00 02 10 00];
		qcom,mdss-dsi-on-command = [
			29 01 00 00 01 00 02 E0 00
			29 01 00 00 01 00 02 E1 93
			29 01 00 00 01 00 02 E2 65
			29 01 00 00 01 00 02 E3 F8
			29 01 00 00 01 00 02 80 03
			29 01 00 00 01 00 02 E0 01
			29 01 00 00 01 00 02 00 00
			29 01 00 00 01 00 02 01 44
			29 01 00 00 01 00 02 03 00
			29 01 00 00 01 00 02 04 44
			29 01 00 00 01 00 02 17 00
			29 01 00 00 01 00 02 18 E7
			29 01 00 00 01 00 02 19 00
			29 01 00 00 01 00 02 1A 00
			29 01 00 00 01 00 02 1B E7
			29 01 00 00 01 00 02 1C 00
			29 01 00 00 01 00 02 24 FE
			29 01 00 00 01 00 02 25 20
			29 01 00 00 01 00 02 37 08
			29 01 00 00 01 00 02 38 04
			29 01 00 00 01 00 02 39 00
			29 01 00 00 01 00 02 3A 01
			29 01 00 00 01 00 02 3C 64
			29 01 00 00 01 00 02 3D FF
			29 01 00 00 01 00 02 3E FF
			29 01 00 00 01 00 02 3F FF
			29 01 00 00 01 00 02 40 04
			29 01 00 00 01 00 02 41 be 
			29 01 00 00 01 00 02 42 68
			29 01 00 00 01 00 02 43 18
			29 01 00 00 01 00 02 44 10
			29 01 00 00 01 00 02 45 32
			29 01 00 00 01 00 02 55 0F
			29 01 00 00 01 00 02 56 01
			29 01 00 00 01 00 02 57 66
			29 01 00 00 01 00 02 58 0A
			29 01 00 00 01 00 02 59 0A
			29 01 00 00 01 00 02 5A 28
			29 01 00 00 01 00 02 5B 10
			29 01 00 00 01 00 02 5C 15
			29 01 00 00 01 00 02 5D 7F
			29 01 00 00 01 00 02 5E 60
			29 01 00 00 01 00 02 5F 4D
			29 01 00 00 01 00 02 60 3F
			29 01 00 00 01 00 02 61 3A
			29 01 00 00 01 00 02 62 2A
			29 01 00 00 01 00 02 63 30
			29 01 00 00 01 00 02 64 1C
			29 01 00 00 01 00 02 65 39
			29 01 00 00 01 00 02 66 3B
			29 01 00 00 01 00 02 67 3E
			29 01 00 00 01 00 02 68 5D
			29 01 00 00 01 00 02 69 4B
			29 01 00 00 01 00 02 6A 53
			29 01 00 00 01 00 02 6B 45
			29 01 00 00 01 00 02 6C 42
			29 01 00 00 01 00 02 6D 36
			29 01 00 00 01 00 02 6E 26
			29 01 00 00 01 00 02 6F 12
			29 01 00 00 01 00 02 70 7F
			29 01 00 00 01 00 02 71 60
			29 01 00 00 01 00 02 72 4D
			29 01 00 00 01 00 02 73 3F
			29 01 00 00 01 00 02 74 3A
			29 01 00 00 01 00 02 75 2A
			29 01 00 00 01 00 02 76 30
			29 01 00 00 01 00 02 77 1C
			29 01 00 00 01 00 02 78 39
			29 01 00 00 01 00 02 79 3B
			29 01 00 00 01 00 02 7A 3E
			29 01 00 00 01 00 02 7B 5D
			29 01 00 00 01 00 02 7C 4B
			29 01 00 00 01 00 02 7D 53
			29 01 00 00 01 00 02 7E 45
			29 01 00 00 01 00 02 7F 42
			29 01 00 00 01 00 02 80 36
			29 01 00 00 01 00 02 81 26
			29 01 00 00 01 00 02 82 12
			29 01 00 00 01 00 02 E0 02
			29 01 00 00 01 00 02 00 50
			29 01 00 00 01 00 02 01 5E
			29 01 00 00 01 00 02 02 5F
			29 01 00 00 01 00 02 03 5F
			29 01 00 00 01 00 02 04 4A
			29 01 00 00 01 00 02 05 48
			29 01 00 00 01 00 02 06 46
			29 01 00 00 01 00 02 07 44
			29 01 00 00 01 00 02 08 40
			29 01 00 00 01 00 02 09 5F
			29 01 00 00 01 00 02 0A 5F
			29 01 00 00 01 00 02 0B 5F
			29 01 00 00 01 00 02 0C 5F
			29 01 00 00 01 00 02 0D 5F
			29 01 00 00 01 00 02 0E 5F
			29 01 00 00 01 00 02 0F 5F
			29 01 00 00 01 00 02 10 5F
			29 01 00 00 01 00 02 11 5F
			29 01 00 00 01 00 02 12 5F
			29 01 00 00 01 00 02 13 5F
			29 01 00 00 01 00 02 14 5F
			29 01 00 00 01 00 02 15 5F
			29 01 00 00 01 00 02 16 51
			29 01 00 00 01 00 02 17 5E
			29 01 00 00 01 00 02 18 5F
			29 01 00 00 01 00 02 19 5F
			29 01 00 00 01 00 02 1A 4B
			29 01 00 00 01 00 02 1B 49
			29 01 00 00 01 00 02 1C 47
			29 01 00 00 01 00 02 1D 45
			29 01 00 00 01 00 02 1E 41
			29 01 00 00 01 00 02 1F 5F
			29 01 00 00 01 00 02 20 5F
			29 01 00 00 01 00 02 21 5F
			29 01 00 00 01 00 02 22 5F
			29 01 00 00 01 00 02 23 5F
			29 01 00 00 01 00 02 24 5F
			29 01 00 00 01 00 02 25 5F
			29 01 00 00 01 00 02 26 5F
			29 01 00 00 01 00 02 27 5F
			29 01 00 00 01 00 02 28 5F
			29 01 00 00 01 00 02 29 5F
			29 01 00 00 01 00 02 2A 5F
			29 01 00 00 01 00 02 2B 5F
			29 01 00 00 01 00 02 2C 01
			29 01 00 00 01 00 02 2D 1F
			29 01 00 00 01 00 02 2E 1E
			29 01 00 00 01 00 02 2F 1F
			29 01 00 00 01 00 02 30 05
			29 01 00 00 01 00 02 31 07
			29 01 00 00 01 00 02 32 09
			29 01 00 00 01 00 02 33 0B
			29 01 00 00 01 00 02 34 11
			29 01 00 00 01 00 02 35 1F
			29 01 00 00 01 00 02 36 1F
			29 01 00 00 01 00 02 37 1F
			29 01 00 00 01 00 02 38 1F
			29 01 00 00 01 00 02 39 1F
			29 01 00 00 01 00 02 3A 1F
			29 01 00 00 01 00 02 3B 1F
			29 01 00 00 01 00 02 3C 1F
			29 01 00 00 01 00 02 3D 1F
			29 01 00 00 01 00 02 3E 1F
			29 01 00 00 01 00 02 3F 1F
			29 01 00 00 01 00 02 40 1F
			29 01 00 00 01 00 02 41 1F
			29 01 00 00 01 00 02 42 00
			29 01 00 00 01 00 02 43 1F
			29 01 00 00 01 00 02 44 1E
			29 01 00 00 01 00 02 45 1F
			29 01 00 00 01 00 02 46 04
			29 01 00 00 01 00 02 47 06
			29 01 00 00 01 00 02 48 08
			29 01 00 00 01 00 02 49 0A
			29 01 00 00 01 00 02 4A 10
			29 01 00 00 01 00 02 4B 1F
			29 01 00 00 01 00 02 4C 1F
			29 01 00 00 01 00 02 4D 1F
			29 01 00 00 01 00 02 4E 1F
			29 01 00 00 01 00 02 4F 1F
			29 01 00 00 01 00 02 50 1F
			29 01 00 00 01 00 02 51 1F
			29 01 00 00 01 00 02 52 1F
			29 01 00 00 01 00 02 53 1F
			29 01 00 00 01 00 02 54 1F
			29 01 00 00 01 00 02 55 1F
			29 01 00 00 01 00 02 56 1F
			29 01 00 00 01 00 02 57 1F
			29 01 00 00 01 00 02 58 40
			29 01 00 00 01 00 02 59 00
			29 01 00 00 01 00 02 5A 00
			29 01 00 00 01 00 02 5B 10
			29 01 00 00 01 00 02 5C 09
			29 01 00 00 01 00 02 5D 70
			29 01 00 00 01 00 02 5E 01
			29 01 00 00 01 00 02 5F 02
			29 01 00 00 01 00 02 60 40
			29 01 00 00 01 00 02 61 01
			29 01 00 00 01 00 02 62 02
			29 01 00 00 01 00 02 63 54
			29 01 00 00 01 00 02 64 54
			29 01 00 00 01 00 02 65 55
			29 01 00 00 01 00 02 66 FF
			29 01 00 00 01 00 02 67 74
			29 01 00 00 01 00 02 68 0D
			29 01 00 00 01 00 02 69 54
			29 01 00 00 01 00 02 6A 54
			29 01 00 00 01 00 02 6B 18
			29 01 00 00 01 00 02 6C 00
			29 01 00 00 01 00 02 6D 00
			29 01 00 00 01 00 02 6E 00
			29 01 00 00 01 00 02 6F 80
			29 01 00 00 01 00 02 E0 04
			29 01 00 00 01 00 02 09 10
			29 01 00 00 01 00 02 0E 4A
			29 01 00 00 01 00 02 96 0A
			29 01 00 00 01 00 02 E0 00
			05 01 00 00 01 00 02 35 00
			05 01 00 00 78 00 02 11 00
			05 01 00 00 14 00 02 29 00];
		qcom,mdss-dsi-on-command-state = "dsi_lp_mode";
		qcom,mdss-dsi-off-command-state = "dsi_hs_mode";
		qcom,mdss-dsi-panel-timings = [6b 14 0c 00 36 38 12 18 11 03 04 00];
		qcom,mdss-dsi-t-clk-post = <0x5>;
		qcom,mdss-dsi-t-clk-pre = <0x17>;
		qcom,mdss-dsi-h-sync-pulse = <0>;
		qcom,mdss-dsi-traffic-mode = "non_burst_sync_event";
		qcom,mdss-dsi-lane-map = "lane_map_0123";
		qcom,mdss-dsi-bllp-eof-power-mode;
		qcom,mdss-dsi-bllp-power-mode;
		qcom,mdss-dsi-bl-pmic-control-type = "bl_ctrl_pwm";
		qcom,mdss-dsi-bl-pmic-pwm-frequency = <100>;
		qcom,mdss-dsi-bl-pmic-bank-select = <0>;
		qcom,mdss-dsi-pwm-gpio = <&pm8916_mpps 4 0>;
		qcom,mdss-dsi-bl-min-level = <1>;
		qcom,mdss-dsi-bl-max-level = <255>;
		qcom,mdss-dsi-dma-trigger = "trigger_sw";
		qcom,mdss-dsi-mdp-trigger = "none";
		qcom,mdss-dsi-tx-eot-append;
		qcom,mdss-dsi-lane-0-state;
		qcom,mdss-dsi-lane-1-state;
		qcom,mdss-dsi-lane-2-state;
		qcom,mdss-dsi-lane-3-state;
		qcom,mdss-dsi-reset-sequence = <1 5>, <0 5>, <1 120>;
		qcom,mdss-dsi-lp11-init;
		qcom,mdss-dsi-post-init-delay = <2>;
	};
};
